## Documentation/devicetree/bindings/power/allwinner,sun50i-a133-gpu-power-domain.yaml
```yaml
# SPDX-License-Identifier: (GPL-2.0-only OR BSD-2-Clause)
%YAML 1.2
---
$id: http://devicetree.org/schemas/power/allwinner,sun50i-a133-gpu-power-domain.yaml#
$schema: http://devicetree.org/meta-schemas/core.yaml#

title: Allwinner A133 GPU power domain

maintainers:
  - Jack Kingston <998656+jkingston@users.noreply.github.com>

properties:
  compatible:
    const: allwinner,sun50i-a133-gpu-power-domain
  reg:
    maxItems: 1
  clocks:
    items:
      - description: GPU core clock
      - description: GPU bus clock
      - description: PPU bus clock
  clock-names:
    items:
      - const: core
      - const: bus
      - const: ppu
  resets:
    items:
      - description: GPU reset
      - description: PPU reset
  reset-names:
    items:
      - const: gpu
      - const: ppu
  '#power-domain-cells':
    const: 0

required:
  - compatible
  - reg
  - clocks
  - clock-names
  - resets
  - reset-names
  - '#power-domain-cells'

additionalProperties: false
```

## Documentation/devicetree/bindings/pwm/allwinner,sun50i-a133-pwm.yaml
```yaml
# SPDX-License-Identifier: (GPL-2.0-only OR BSD-2-Clause)
%YAML 1.2
---
$id: http://devicetree.org/schemas/pwm/allwinner,sun50i-a133-pwm.yaml#
$schema: http://devicetree.org/meta-schemas/core.yaml#

title: Allwinner A133 PWM controller

maintainers:
  - Jack Kingston <998656+jkingston@users.noreply.github.com>

allOf:
  - $ref: pwm.yaml#

properties:
  compatible:
    const: allwinner,sun50i-a133-pwm
  reg:
    maxItems: 1
  clocks:
    items:
      - description: Bus clock
      - description: 24 MHz oscillator
  clock-names:
    items:
      - const: bus
      - const: osc24M
  resets:
    maxItems: 1
  '#pwm-cells':
    const: 3

required:
  - compatible
  - reg
  - clocks
  - clock-names
  - resets
  - '#pwm-cells'

unevaluatedProperties: false
```

## Documentation/devicetree/bindings/regulator/tcs,tcs4838.yaml
```yaml
# SPDX-License-Identifier: (GPL-2.0-only OR BSD-2-Clause)
%YAML 1.2
---
$id: http://devicetree.org/schemas/regulator/tcs,tcs4838.yaml#
$schema: http://devicetree.org/meta-schemas/core.yaml#

title: TCS4838 single-output buck regulator

maintainers:
  - Jack Kingston <998656+jkingston@users.noreply.github.com>

description: |
  The TCS4838 has one output and two voltage register banks. The SEL pin
  selects the bank; the banks are not independent supplies. This binding
  describes boards holding SEL low during normal operation, with the output
  enabled by the boot firmware. Suspend bank switching is not described.

allOf:
  - $ref: regulator.yaml#

properties:
  compatible:
    const: tcs,tcs4838

  reg:
    maxItems: 1

  tcs,runtime-voltage-selector:
    $ref: /schemas/types.yaml#/definitions/uint32
    const: 0
    description: Runtime voltage bank selected by the board's SEL wiring.

  regulator-always-on: true

  regulator-min-microvolt:
    minimum: 712500
    maximum: 1500000

  regulator-max-microvolt:
    minimum: 712500
    maximum: 1500000

  regulator-initial-mode: false
  regulator-ramp-delay: false
  regulator-state-mem: false
  regulator-state-disk: false
  regulator-state-standby: false

required:
  - compatible
  - reg
  - tcs,runtime-voltage-selector
  - regulator-always-on

unevaluatedProperties: false

examples:
  - |
    i2c {
        #address-cells = <1>;
        #size-cells = <0>;
        regulator@41 {
            compatible = "tcs,tcs4838";
            reg = <0x41>;
            regulator-name = "vdd-cpu";
            regulator-min-microvolt = <712500>;
            regulator-max-microvolt = <1500000>;
            regulator-always-on;
            tcs,runtime-voltage-selector = <0>;
        };
    };
```

## Documentation/devicetree/bindings/regulator/trimui,brick-panel-supplies.yaml
```yaml
# SPDX-License-Identifier: (GPL-2.0-only OR BSD-2-Clause)
%YAML 1.2
---
$id: http://devicetree.org/schemas/regulator/trimui,brick-panel-supplies.yaml#
$schema: http://devicetree.org/meta-schemas/core.yaml#

title: TrimUI Brick panel supplies

maintainers:
  - Jack Kingston <998656+jkingston@users.noreply.github.com>

description: |
  Panel supply interface at I2C address 0x34. CLDO1 is a shared,
  boot-enabled 1.8 V rail; CLDO4 supplies the panel at 3.3 V.
  The driver preserves inherited voltage selectors and shared CLDO1.

properties:
  compatible:
    const: trimui,brick-panel-supplies
  reg:
    maxItems: 1
  regulators:
    type: object
    additionalProperties: false
    properties:
      cldo1:
        type: object
        $ref: regulator.yaml#
        unevaluatedProperties: false
        required:
          - regulator-always-on
      cldo4:
        type: object
        $ref: regulator.yaml#
        unevaluatedProperties: false
    required:
      - cldo1
      - cldo4

required:
  - compatible
  - reg
  - regulators

additionalProperties: false
```

## Documentation/devicetree/bindings/rtc/trimui,brick-rtc.yaml
```yaml
# SPDX-License-Identifier: (GPL-2.0-only OR BSD-2-Clause)
%YAML 1.2
---
$id: http://devicetree.org/schemas/rtc/trimui,brick-rtc.yaml#
$schema: http://devicetree.org/meta-schemas/core.yaml#

title: TrimUI Brick retained Allwinner A133 RTC

maintainers:
  - Jack Kingston <998656+jkingston@users.noreply.github.com>

description: |
  The TrimUI Brick retains an A133 RTC counter initialized by its boot
  firmware. Official Brick firmware stores one-based days from 1970-01-01.
  The board-specific compatible identifies this retained counter convention;
  it is not an intrinsic epoch of the A133 hardware.

  The RTC bus clock permits register access independently of the oscillator
  and clock outputs. The inherited RTC reset, oscillator selection and radio
  source configuration must be preserved. The RTC owns shared radio output
  gates: index 0 is LPO fanout, index 1 is DCXO peripheral reference.
  This board path requires valid inherited clock sources; it does not change
  mux, divider, oscillator trim or calibration.
  Suspend-to-idle retains the bus clock and radio outputs. A trusted alarm
  explicitly programmed by the RTC driver can wake through its alarm IRQ;
  inherited alarms are preserved without granting them wake ownership.
  Deep suspend and hibernation are not supported by this retained-state path.

allOf:
  - $ref: rtc.yaml#

properties:
  compatible:
    items:
      - const: trimui,brick-rtc
      - const: allwinner,sun50i-a133-rtc

  reg:
    maxItems: 1

  interrupts:
    maxItems: 1
    description: RTC alarm interrupt

  clocks:
    maxItems: 1
    description: Bus clock for register access

  clock-names:
    const: bus

  resets:
    maxItems: 1
    description: RTC bus reset, which must already be deasserted by firmware

  reset-names:
    const: bus

  "#clock-cells":
    const: 1

  start-year: false

required:
  - compatible
  - reg
  - interrupts
  - clocks
  - clock-names
  - resets
  - reset-names
  - "#clock-cells"

unevaluatedProperties: false

examples:
  - |
    #include <dt-bindings/clock/sun50i-a100-r-ccu.h>
    #include <dt-bindings/interrupt-controller/arm-gic.h>
    #include <dt-bindings/reset/sun50i-a100-r-ccu.h>

    rtc@7000000 {
        compatible = "trimui,brick-rtc", "allwinner,sun50i-a133-rtc";
        reg = <0x07000000 0x200>;
        #clock-cells = <1>;
        interrupts = <GIC_SPI 108 IRQ_TYPE_LEVEL_HIGH>;
        clocks = <&r_ccu CLK_R_AHB_BUS_RTC>;
        clock-names = "bus";
        resets = <&r_ccu RST_R_AHB_BUS_RTC>;
        reset-names = "bus";
    };
```

## Documentation/devicetree/bindings/soc/allwinner/allwinner,sun50i-a133-video-engine-domain.yaml
```yaml
# SPDX-License-Identifier: (GPL-2.0-only OR BSD-2-Clause)
%YAML 1.2
---
$id: http://devicetree.org/schemas/soc/allwinner/allwinner,sun50i-a133-video-engine-domain.yaml#
$schema: http://devicetree.org/meta-schemas/core.yaml#

title: Allwinner A133 shared video-engine domain

maintainers:
  - Chen-Yu Tsai <wens@csie.org>
  - Jernej Skrabec <jernej.skrabec@gmail.com>

description:
  The A133 Cedrus and Hantro G2 decoder blocks share one module clock, bus
  clock, memory-bus clock and reset line. This domain serializes ownership so
  recovery of one decoder cannot reset an active peer.

properties:
  compatible:
    const: allwinner,sun50i-a133-video-engine-domain

  clocks:
    items:
      - description: Bus clock
      - description: Module clock
      - description: Memory-bus clock

  clock-names:
    items:
      - const: ahb
      - const: mod
      - const: ram

  resets:
    maxItems: 1

required:
  - compatible
  - clocks
  - clock-names
  - resets

additionalProperties: false

examples:
  - |
    #include <dt-bindings/clock/sun50i-a100-ccu.h>
    #include <dt-bindings/reset/sun50i-a100-ccu.h>

    video-engine-domain {
        compatible = "allwinner,sun50i-a133-video-engine-domain";
        clocks = <&ccu CLK_BUS_VE>, <&ccu CLK_VE>, <&ccu CLK_MBUS_VE>;
        clock-names = "ahb", "mod", "ram";
        resets = <&ccu RST_BUS_VE>;
    };
...
```

## Documentation/devicetree/bindings/sound/allwinner,sun50i-a133-codec.yaml
```yaml
# SPDX-License-Identifier: (GPL-2.0-only OR BSD-2-Clause)
%YAML 1.2
---
$id: http://devicetree.org/schemas/sound/allwinner,sun50i-a133-codec.yaml#
$schema: http://devicetree.org/meta-schemas/core.yaml#

title: Allwinner A133 Internal Audio Codec

maintainers:
  - Jack Kingston <998656+jkingston@users.noreply.github.com>

description: |
  The A133 codec combines digital DMA FIFOs with direct MMIO analog controls.
  Initial support covers stereo headphone playback and an external amplifier
  connected to those outputs. Its analog register layout is not compatible
  with the H616 codec.

allOf:
  - $ref: dai-common.yaml#

properties:
  compatible:
    const: allwinner,sun50i-a133-codec
  '#sound-dai-cells':
    const: 0
  reg:
    maxItems: 1
  interrupts:
    maxItems: 1
  clocks:
    items:
      - description: APB bus clock
      - description: DAC module clock
      - description: Audio PLL
      - description: COM PLL divided by five
  clock-names:
    items:
      - const: apb
      - const: codec
      - const: pll-audio
      - const: pll-com-audio
  resets:
    maxItems: 1
  dmas:
    items:
      - description: TX DMA channel
  dma-names:
    items:
      - const: tx
  avcc-supply:
    description: Analog 1.8 V supply
  cpvin-supply:
    description: Headphone charge pump 1.8 V input supply
  allwinner,pa-gpios:
    maxItems: 1
    description: GPIO enabling the external speaker amplifier
  allwinner,pa-delay-ms:
    description: Settling time after enabling the external speaker amplifier
    default: 0
    maximum: 1000
  allwinner,audio-routing:
    $ref: /schemas/types.yaml#/definitions/non-unique-string-array
    description: Connections between the board outputs and codec outputs.
    minItems: 4
    maxItems: 8
    items:
      enum: [Headphone, Speaker, HPOUTL, HPOUTR]

required:
  - compatible
  - '#sound-dai-cells'
  - reg
  - interrupts
  - clocks
  - clock-names
  - resets
  - dmas
  - dma-names
  - avcc-supply
  - cpvin-supply
  - allwinner,audio-routing

unevaluatedProperties: false
```

## Documentation/devicetree/bindings/usb/trimui,brick-usb-role-switch.yaml
```yaml
# SPDX-License-Identifier: (GPL-2.0-only OR BSD-2-Clause)
%YAML 1.2
---
$id: http://devicetree.org/schemas/usb/trimui,brick-usb-role-switch.yaml#
$schema: http://devicetree.org/meta-schemas/core.yaml#

title: TrimUI Brick bottom USB controller role coordinator

maintainers:
  - Jack Kingston <998656+jkingston@users.noreply.github.com>

description: |
  The bottom PHY is routed between a peripheral MUSB controller and an EHCI/OHCI
  host pair. All three referenced controller nodes must be disabled; this owner
  instantiates only the active group. The top USB host remains independent.

properties:
  compatible:
    const: trimui,brick-usb-role-switch
  phys:
    maxItems: 1
  phy-names:
    const: usb
  id-gpios:
    maxItems: 1
  vbus-power-supply:
    description: AXP2202 USB input supply, identified by the PMIC node.
  peripheral:
    $ref: /schemas/types.yaml#/definitions/phandle
    description: Disabled bottom MUSB controller.
  ehci:
    $ref: /schemas/types.yaml#/definitions/phandle
    description: Disabled bottom EHCI controller.
  ohci:
    $ref: /schemas/types.yaml#/definitions/phandle
    description: Disabled bottom OHCI controller.

required:
  - compatible
  - phys
  - phy-names
  - id-gpios
  - vbus-power-supply
  - peripheral
  - ehci
  - ohci

additionalProperties: false
```
