## arch/arm64/configs/trimui_brick_defconfig
```kconfig
CONFIG_LOCALVERSION="-brick-dev"
# CONFIG_LOCALVERSION_AUTO is not set
CONFIG_SYSVIPC=y
CONFIG_POSIX_MQUEUE=y
CONFIG_NO_HZ_IDLE=y
CONFIG_HIGH_RES_TIMERS=y
CONFIG_PREEMPT=y
CONFIG_IRQ_TIME_ACCOUNTING=y
CONFIG_IKCONFIG=y
CONFIG_IKCONFIG_PROC=y
CONFIG_MEMCG=y
CONFIG_BLK_CGROUP=y
CONFIG_CGROUP_PIDS=y
CONFIG_CGROUP_FREEZER=y
CONFIG_CPUSETS=y
CONFIG_CGROUP_DEVICE=y
CONFIG_CGROUP_CPUACCT=y
CONFIG_CGROUP_PERF=y
CONFIG_USER_NS=y
CONFIG_SCHED_AUTOGROUP=y
CONFIG_BLK_DEV_INITRD=y
CONFIG_PERF_EVENTS=y
CONFIG_ARCH_SUNXI=y
# CONFIG_AMPERE_ERRATUM_AC03_CPU_38 is not set
# CONFIG_AMPERE_ERRATUM_AC04_CPU_23 is not set
# CONFIG_ARM64_ERRATUM_832075 is not set
# CONFIG_ARM64_ERRATUM_1742098 is not set
# CONFIG_ARM64_ERRATUM_1024718 is not set
# CONFIG_ARM64_ERRATUM_1418040 is not set
# CONFIG_ARM64_ERRATUM_1165522 is not set
# CONFIG_ARM64_ERRATUM_1319367 is not set
# CONFIG_ARM64_ERRATUM_1530923 is not set
# CONFIG_ARM64_ERRATUM_1463225 is not set
# CONFIG_ARM64_ERRATUM_1508412 is not set
# CONFIG_ARM64_ERRATUM_2051678 is not set
# CONFIG_ARM64_ERRATUM_2077057 is not set
# CONFIG_ARM64_ERRATUM_2658417 is not set
# CONFIG_ARM64_ERRATUM_2054223 is not set
# CONFIG_ARM64_ERRATUM_2067961 is not set
# CONFIG_ARM64_ERRATUM_2457168 is not set
# CONFIG_ARM64_ERRATUM_2645198 is not set
# CONFIG_ARM64_ERRATUM_3821522 is not set
# CONFIG_ARM64_ERRATUM_2966298 is not set
# CONFIG_ARM64_ERRATUM_3117295 is not set
# CONFIG_ARM64_ERRATUM_3194386 is not set
# CONFIG_ARM64_ERRATUM_4311569 is not set
# CONFIG_CAVIUM_ERRATUM_22375 is not set
# CONFIG_CAVIUM_ERRATUM_23154 is not set
# CONFIG_CAVIUM_ERRATUM_27456 is not set
# CONFIG_CAVIUM_ERRATUM_30115 is not set
# CONFIG_CAVIUM_TX2_ERRATUM_219 is not set
# CONFIG_FUJITSU_ERRATUM_010001 is not set
# CONFIG_HISILICON_ERRATUM_161600802 is not set
# CONFIG_HISILICON_ERRATUM_162100801 is not set
# CONFIG_HISILICON_ERRATUM_162100125 is not set
# CONFIG_QCOM_FALKOR_ERRATUM_1003 is not set
# CONFIG_QCOM_FALKOR_ERRATUM_1009 is not set
# CONFIG_QCOM_FALKOR_ERRATUM_E1041 is not set
# CONFIG_NVIDIA_CARMEL_CNP_ERRATUM is not set
# CONFIG_NVIDIA_OLYMPUS_1027_ERRATUM is not set
CONFIG_NR_CPUS=4
CONFIG_COMPAT=y
# CONFIG_ARM64_PTR_AUTH is not set
# CONFIG_ARM64_BTI is not set
# CONFIG_ARM64_MTE is not set
# CONFIG_ARM64_GCS is not set
# CONFIG_ARM64_SVE is not set
CONFIG_RANDOMIZE_BASE=y
# CONFIG_EFI is not set
CONFIG_WQ_POWER_EFFICIENT_DEFAULT=y
CONFIG_ENERGY_MODEL=y
CONFIG_CPU_IDLE=y
CONFIG_ARM_PSCI_CPUIDLE=y
CONFIG_CPU_FREQ=y
CONFIG_CPU_FREQ_STAT=y
CONFIG_CPU_FREQ_DEFAULT_GOV_ONDEMAND=y
CONFIG_CPU_FREQ_GOV_USERSPACE=y
CONFIG_CPUFREQ_DT=y
CONFIG_ARM_ALLWINNER_SUN50I_CPUFREQ_NVMEM=y
CONFIG_MODULES=y
CONFIG_MODULE_UNLOAD=y
CONFIG_BLK_DEV_BSGLIB=y
# CONFIG_CORE_DUMP_DEFAULT_ELF_HEADERS is not set
# CONFIG_COMPAT_BRK is not set
CONFIG_CMA=y
CONFIG_CMA_AREAS=20
CONFIG_NET=y
CONFIG_PACKET=y
CONFIG_UNIX=y
CONFIG_INET=y
# CONFIG_IPV6_SIT is not set
CONFIG_BT=m
CONFIG_BT_RFCOMM=m
CONFIG_BT_RFCOMM_TTY=y
CONFIG_BT_BNEP=m
CONFIG_BT_BNEP_MC_FILTER=y
CONFIG_BT_BNEP_PROTO_FILTER=y
CONFIG_BT_HIDP=m
CONFIG_BT_HCIUART=m
CONFIG_BT_HCIUART_XRADIO=m
CONFIG_CFG80211=m
CONFIG_MAC80211=m
CONFIG_RFKILL=m
CONFIG_DEVTMPFS=y
CONFIG_DEVTMPFS_MOUNT=y
# CONFIG_SUNXI_RSB is not set
CONFIG_SRAM=y
CONFIG_SCSI=y
CONFIG_BLK_DEV_SD=m
CONFIG_NETDEVICES=y
# CONFIG_ETHERNET is not set
# CONFIG_RTL_CARDS is not set
CONFIG_XRADIO=m
CONFIG_INPUT_MATRIXKMAP=y
CONFIG_INPUT_JOYDEV=m
CONFIG_INPUT_EVDEV=y
CONFIG_KEYBOARD_GPIO=y
CONFIG_INPUT_JOYSTICK=y
CONFIG_JOYSTICK_XPAD=m
CONFIG_JOYSTICK_XPAD_FF=y
CONFIG_JOYSTICK_XPAD_LEDS=y
CONFIG_INPUT_MISC=y
CONFIG_INPUT_GPIO_VIBRA=y
CONFIG_INPUT_AXP2202_PEK=y
# CONFIG_SERIO_SERPORT is not set
CONFIG_LEGACY_PTY_COUNT=16
CONFIG_SERIAL_8250=y
CONFIG_SERIAL_8250_CONSOLE=y
CONFIG_SERIAL_8250_NR_UARTS=8
CONFIG_SERIAL_8250_EXTENDED=y
CONFIG_SERIAL_8250_SHARE_IRQ=y
CONFIG_SERIAL_8250_DW=y
CONFIG_SERIAL_OF_PLATFORM=y
CONFIG_SERIAL_DEV_BUS=y
CONFIG_HW_RANDOM=y
CONFIG_I2C_CHARDEV=y
CONFIG_I2C_DESIGNWARE_CORE=y
# CONFIG_I2C_DESIGNWARE_PLATFORM is not set
CONFIG_I2C_MV64XXX=y
# CONFIG_PINCTRL_SUN8I_H3_R is not set
# CONFIG_PINCTRL_SUN50I_A64 is not set
# CONFIG_PINCTRL_SUN50I_A64_R is not set
# CONFIG_PINCTRL_SUN50I_H5 is not set
# CONFIG_PINCTRL_SUN50I_H6 is not set
# CONFIG_PINCTRL_SUN50I_H6_R is not set
# CONFIG_PINCTRL_SUN50I_H616 is not set
# CONFIG_PINCTRL_SUN50I_H616_R is not set
# CONFIG_PINCTRL_SUN55I_A523 is not set
# CONFIG_PINCTRL_SUN55I_A523_R is not set
CONFIG_POWER_SEQUENCING=y
CONFIG_BATTERY_AXP2202_TELEMETRY=y
CONFIG_THERMAL=y
CONFIG_THERMAL_GOV_POWER_ALLOCATOR=y
CONFIG_CPU_THERMAL=y
CONFIG_DEVFREQ_THERMAL=y
CONFIG_SUN8I_THERMAL=y
CONFIG_WATCHDOG=y
CONFIG_WATCHDOG_OPEN_TIMEOUT=30
CONFIG_DW_WATCHDOG=y
CONFIG_SUNXI_WATCHDOG=y
CONFIG_MFD_SYSCON=y
CONFIG_MFD_TRIMUI_BRICK=y
CONFIG_REGULATOR=y
CONFIG_REGULATOR_FIXED_VOLTAGE=y
# CONFIG_REGULATOR_SUN20I is not set
CONFIG_REGULATOR_TRIMUI_BRICK=y
CONFIG_REGULATOR_TCS4838=y
CONFIG_MEDIA_SUPPORT=y
CONFIG_MEDIA_PLATFORM_SUPPORT=y
CONFIG_V4L_MEM2MEM_DRIVERS=y
CONFIG_VIDEO_SUN8I_ROTATE=m
CONFIG_DRM=y
CONFIG_DRM_FBDEV_OVERALLOC=300
CONFIG_DRM_PANEL_TRIMUI_BRICK=y
CONFIG_DRM_SUN4I=y
# CONFIG_DRM_SUN8I_DW_HDMI is not set
CONFIG_DRM_IMG_ROGUE=m
CONFIG_DRM_IMG_BRICK_DC_METADATA=m
CONFIG_FB=y
CONFIG_BACKLIGHT_CLASS_DEVICE=y
CONFIG_BACKLIGHT_PWM=y
CONFIG_LOGO=y
CONFIG_SOUND=y
CONFIG_SND=y
CONFIG_SND_DYNAMIC_MINORS=y
# CONFIG_SND_VERBOSE_PROCFS is not set
# CONFIG_SND_DRIVERS is not set
CONFIG_SND_USB_AUDIO=m
CONFIG_SND_SOC=y
CONFIG_SND_SUN4I_CODEC=y
CONFIG_HIDRAW=y
CONFIG_UHID=m
CONFIG_HID_LOGITECH=m
CONFIG_HID_LOGITECH_DJ=m
CONFIG_HID_MICROSOFT=m
CONFIG_HID_NINTENDO=m
CONFIG_HID_PLAYSTATION=m
CONFIG_HID_SONY=m
CONFIG_HID_STEAM=m
CONFIG_HID_XINMO=m
CONFIG_USB=y
CONFIG_USB_OTG=y
CONFIG_USB_EHCI_HCD=y
CONFIG_USB_EHCI_ROOT_HUB_TT=y
CONFIG_USB_EHCI_HCD_PLATFORM=y
CONFIG_USB_OHCI_HCD=y
CONFIG_USB_OHCI_HCD_PLATFORM=y
CONFIG_USB_ACM=m
CONFIG_USB_STORAGE=m
CONFIG_USB_UAS=m
CONFIG_USB_MUSB_HDRC=y
CONFIG_USB_MUSB_GADGET=y
CONFIG_USB_MUSB_SUNXI=y
CONFIG_NOP_USB_XCEIV=y
CONFIG_USB_GADGET=y
CONFIG_USB_CONFIGFS=y
CONFIG_USB_CONFIGFS_ACM=y
CONFIG_USB_CONFIGFS_ECM=y
CONFIG_USB_CONFIGFS_F_FS=y
CONFIG_USB_ROLE_SWITCH=y
CONFIG_USB_ROLES_TRIMUI_BRICK=y
CONFIG_MMC=y
CONFIG_MMC_BLOCK_MINORS=32
CONFIG_PWRSEQ_BRICK_RADIO=y
CONFIG_MMC_SUNXI=y
CONFIG_NEW_LEDS=y
CONFIG_LEDS_CLASS=y
CONFIG_LEDS_CLASS_MULTICOLOR=y
CONFIG_LEDS_SUN50I_A100=y
CONFIG_RTC_CLASS=y
# CONFIG_RTC_SYSTOHC is not set
CONFIG_RTC_DRV_TRIMUI_BRICK=y
CONFIG_RTC_DRV_SUN6I=y
CONFIG_DMADEVICES=y
CONFIG_DMA_SUN6I=y
CONFIG_DMABUF_HEAPS=y
CONFIG_DMABUF_HEAPS_SYSTEM=m
CONFIG_DMABUF_HEAPS_CMA=m
# CONFIG_VIRTIO_MENU is not set
# CONFIG_VHOST_MENU is not set
CONFIG_STAGING=y
CONFIG_STAGING_MEDIA=y
CONFIG_VIDEO_SUNXI=y
CONFIG_VIDEO_SUNXI_CEDRUS=y
# CONFIG_SUN50I_A64_CCU is not set
# CONFIG_SUN50I_H6_CCU is not set
# CONFIG_SUN50I_H616_CCU is not set
# CONFIG_SUN50I_H6_R_CCU is not set
# CONFIG_SUN55I_A523_CCU is not set
# CONFIG_SUN55I_A523_MCU_CCU is not set
# CONFIG_SUN55I_A523_R_CCU is not set
# CONFIG_SUN8I_H3_CCU is not set
# CONFIG_SUN8I_R_CCU is not set
# CONFIG_HISILICON_ERRATUM_161010101 is not set
# CONFIG_ARM64_ERRATUM_858921 is not set
CONFIG_MAILBOX=y
# CONFIG_SUN6I_MSGBOX is not set
CONFIG_IOMMU_IO_PGTABLE_LPAE=y
CONFIG_SUN50I_A133_IOMMU=y
# CONFIG_SUN20I_PPU is not set
# CONFIG_SUN55I_PCK600 is not set
CONFIG_SUN50I_A133_GPU_PPU=y
CONFIG_DEVFREQ_GOV_SIMPLE_ONDEMAND=y
CONFIG_PWM=y
CONFIG_PWM_SUN50I_A133=y
CONFIG_PHY_SUN4I_USB=y
CONFIG_NVMEM_SUNXI_SID=y
CONFIG_EXT4_FS=y
CONFIG_EXT4_FS_POSIX_ACL=y
CONFIG_EXT4_FS_SECURITY=y
CONFIG_FANOTIFY=y
CONFIG_OVERLAY_FS=m
CONFIG_VFAT_FS=y
CONFIG_TMPFS=y
CONFIG_TMPFS_POSIX_ACL=y
CONFIG_SQUASHFS=y
CONFIG_NLS_CODEPAGE_437=y
CONFIG_NLS_ISO8859_1=y
CONFIG_SECURITY=y
CONFIG_SECURITYFS=y
CONFIG_CRYPTO_USER=y
CONFIG_CRYPTO_AUTHENC=y
CONFIG_CRYPTO_BENCHMARK=m
CONFIG_CRYPTO_AES=y
CONFIG_CRYPTO_CAMELLIA=y
CONFIG_CRYPTO_CBC=y
CONFIG_CRYPTO_CTS=y
CONFIG_CRYPTO_ECHAINIV=y
CONFIG_CRYPTO_CMAC=y
CONFIG_CRYPTO_HMAC=y
CONFIG_CRYPTO_SHA1=y
CONFIG_CRYPTO_SHA256=y
CONFIG_CRYPTO_SHA512=y
CONFIG_CRYPTO_LZO=y
CONFIG_CRYPTO_LZ4=y
CONFIG_CRYPTO_GHASH_ARM64_CE=y
CONFIG_CRYPTO_AES_ARM64_CE_CCM=y
CONFIG_CRYPTO_DEV_SUN50I_A133_CE=m
CONFIG_PACKING=y
CONFIG_DMA_RESTRICTED_POOL=y
CONFIG_DMA_CMA=y
CONFIG_CMA_SIZE_MBYTES=64
CONFIG_PRINTK_TIME=y
CONFIG_DEBUG_KERNEL=y
CONFIG_MAGIC_SYSRQ=y
CONFIG_DEBUG_FS=y
# CONFIG_FTRACE is not set
```

## drivers/crypto/allwinner/Kconfig
```kconfig
config CRYPTO_DEV_ALLWINNER
	bool "Support for Allwinner cryptographic offloader"
	depends on ARCH_SUNXI || COMPILE_TEST
	default y if ARCH_SUNXI
	help
	  Say Y here to get to see options for Allwinner hardware crypto devices

config CRYPTO_DEV_SUN4I_SS
	tristate "Support for Allwinner Security System cryptographic accelerator"
	depends on ARCH_SUNXI
	depends on PM
	depends on CRYPTO_DEV_ALLWINNER
	select CRYPTO_MD5
	select CRYPTO_SHA1
	select CRYPTO_AES
	select CRYPTO_LIB_DES
	select CRYPTO_SKCIPHER
	help
	  Some Allwinner SoC have a crypto accelerator named
	  Security System. Select this if you want to use it.
	  The Security System handle AES/DES/3DES ciphers in CBC mode
	  and SHA1 and MD5 hash algorithms.

	  To compile this driver as a module, choose M here: the module
	  will be called sun4i-ss.

config CRYPTO_DEV_SUN4I_SS_DEBUG
	bool "Enable sun4i-ss stats"
	depends on CRYPTO_DEV_SUN4I_SS
	depends on DEBUG_FS
	help
	  Say y to enable sun4i-ss debug stats.
	  This will create /sys/kernel/debug/sun4i-ss/stats for displaying
	  the number of requests per algorithm.

config CRYPTO_DEV_SUN8I_CE
	tristate "Support for Allwinner Crypto Engine cryptographic offloader"
	select CRYPTO_SKCIPHER
	select CRYPTO_ENGINE
	select CRYPTO_ECB
	select CRYPTO_CBC
	select CRYPTO_AES
	select CRYPTO_DES
	depends on CRYPTO_DEV_ALLWINNER
	depends on PM
	help
	  Select y here to have support for the crypto Engine available on
	  Allwinner SoC H2+, H3, H5, H6, R40 and A64.
	  The Crypto Engine handle AES/3DES ciphers in ECB/CBC mode.

	  To compile this driver as a module, choose M here: the module
	  will be called sun8i-ce.

config CRYPTO_DEV_SUN8I_CE_DEBUG
	bool "Enable sun8i-ce stats"
	depends on CRYPTO_DEV_SUN8I_CE
	depends on DEBUG_FS
	help
	  Say y to enable sun8i-ce debug stats.
	  This will create /sys/kernel/debug/sun8i-ce/stats for displaying
	  the number of requests per flow and per algorithm.

config CRYPTO_DEV_SUN8I_CE_HASH
	bool "Enable support for hash on sun8i-ce"
	depends on CRYPTO_DEV_SUN8I_CE
	select CRYPTO_MD5
	select CRYPTO_SHA1
	select CRYPTO_SHA256
	select CRYPTO_SHA512
	help
	  Say y to enable support for hash algorithms.

config CRYPTO_DEV_SUN8I_CE_TRNG
	bool "Support for Allwinner Crypto Engine TRNG"
	depends on CRYPTO_DEV_SUN8I_CE
	select HW_RANDOM
	help
	  Select this option if you want to provide kernel-side support for
	  the True Random Number Generator found in the Crypto Engine.

config CRYPTO_DEV_SUN8I_SS
	tristate "Support for Allwinner Security System cryptographic offloader"
	select CRYPTO_SKCIPHER
	select CRYPTO_ENGINE
	select CRYPTO_ECB
	select CRYPTO_CBC
	select CRYPTO_AES
	select CRYPTO_DES
	depends on CRYPTO_DEV_ALLWINNER
	depends on PM
	help
	  Select y here to have support for the Security System available on
	  Allwinner SoC A80, A83T.
	  The Security System handle AES/3DES ciphers in ECB/CBC mode.

	  To compile this driver as a module, choose M here: the module
	  will be called sun8i-ss.

config CRYPTO_DEV_SUN8I_SS_DEBUG
	bool "Enable sun8i-ss stats"
	depends on CRYPTO_DEV_SUN8I_SS
	depends on DEBUG_FS
	help
	  Say y to enable sun8i-ss debug stats.
	  This will create /sys/kernel/debug/sun8i-ss/stats for displaying
	  the number of requests per flow and per algorithm.

config CRYPTO_DEV_SUN8I_SS_HASH
	bool "Enable support for hash on sun8i-ss"
	depends on CRYPTO_DEV_SUN8I_SS
	select CRYPTO_MD5
	select CRYPTO_SHA1
	select CRYPTO_SHA256
	help
	  Say y to enable support for hash algorithms.

config CRYPTO_DEV_SUN50I_A133_CE
	tristate "Allwinner A133 Crypto Engine AES and SHA-256"
	depends on CRYPTO_DEV_ALLWINNER && PM
	select CRYPTO_SKCIPHER
	select CRYPTO_ECB
	select CRYPTO_CBC
	select CRYPTO_AES
	select CRYPTO_HASH
	select CRYPTO_SHA256
	select SGL_ALLOC
	help
	  AES ECB/CBC and SHA-256 digests on the A133 CE v4, with four
	  concurrent flows and isolated DMA buffers. Larger requests and
	  streaming hash updates use a software fallback.
	  Failed reset containment retains DMA resources until cold power-off.
	  System suspend drains queued work and rebuilds the engine state on
	  resume. Failed quiescence or restoration prevents further requests.

	  The module is called sun50i-a133-ce.

config CRYPTO_DEV_SUN50I_A133_CE_TRNG
	bool "Expose the A133 CE TRNG without entropy credit"
	depends on CRYPTO_DEV_SUN50I_A133_CE
	select HW_RANDOM
	help
	  Expose the A133 CE v4 TRNG transport through /dev/hwrng.  The
	  hardware source has zero registered entropy quality because its health
	  and conditioning guarantees have not been established.  The bytes
	  remain available for direct diagnostics and are mixed into the
	  random pool without crediting entropy.  Hardware errors return no
	  output and use the parent driver's recovery and DMA quarantine path.
	  Keep this disabled until CE operation has been qualified on the target.
	  Entropy credit requires separate source and health evidence.
```

## drivers/gpu/drm/img/Kconfig
```kconfig
# SPDX-License-Identifier: GPL-2.0-only
source "drivers/gpu/drm/img/img-rogue/Kconfig"

config DRM_IMG_BRICK_DC_METADATA
	tristate "TrimUI Brick PowerVR display metadata"
	depends on DRM_IMG_ROGUE
	help
	  Provides display metadata required by the stock NULL_WSEGL
	  pbuffer library. Does not allocate scanout buffers.
```

## drivers/gpu/drm/img/img-rogue/Kconfig
```kconfig
# SPDX-License-Identifier: GPL-2.0-only
config DRM_IMG_ROGUE
	tristate "PowerVR GE8300 vendor driver for Allwinner A133"
	depends on DRM && ARM64 && ARCH_SUNXI
	select FW_LOADER
	help
	  Vendor DDK 1.19 driver for the GE8300 (BVNC 22.102.54.38).
	  Requires matching firmware and userspace libraries.
```

## drivers/media/platform/sunxi/sun8i-rotate/Kconfig
```kconfig
# SPDX-License-Identifier: GPL-2.0-only

config VIDEO_SUN8I_ROTATE
	tristate "Allwinner DE2 rotation driver"
	depends on V4L_MEM2MEM_DRIVERS
	depends on VIDEO_DEV
	depends on ARCH_SUNXI || COMPILE_TEST
	depends on COMMON_CLK && RESET_CONTROLLER && OF
	depends on PM
	select VIDEOBUF2_DMA_CONTIG
	select V4L2_MEM2MEM_DEV
	select MEDIA_CONTROLLER
	select VIDEO_V4L2_SUBDEV_API
	help
	   Support for the Allwinner DE2 and A133 G2D rotation units.
	   A133 also supports RGB/YUV scaling and format conversion, with
	   BT.601/709 limited-range YUV to/from full-range RGB conversion.
	   A133 exposes a two-input RGB source-over compositor. Its mem2mem and
	   compositor queues support MMAP and implicitly synchronized DMA-BUF
	   sharing. Color keying and general raster operations are not implemented.
	   To compile this driver as a module choose m here.
```

## drivers/net/wireless/xradio/Kconfig
```kconfig
# SPDX-License-Identifier: GPL-2.0-only
menuconfig WLAN_VENDOR_XRADIO
	bool "XRadio devices"
	default y
	help
	  Support for XRadio wireless devices.

if WLAN_VENDOR_XRADIO

config XRADIO
	tristate "XRadio XR829 SDIO wireless support"
	depends on MAC80211 && MMC
	help
	  Station-mode support for the 2.4 GHz XR829 SDIO radio. Requires
	  xr829/boot_xr829.bin, xr829/fw_xr829.bin and xr829/sdd_xr829.bin
	  in the firmware search path.

	  System suspend disconnects and powers down the radio, then reloads
	  firmware on resume. Retained association or wake, AP mode, WPA3 and
	  background scanning are not supported. HT20 is experimental and
	  requires the allow_ht option.

	  To build a module, choose M. The module is called xradio_wlan.

endif # WLAN_VENDOR_XRADIO
```
