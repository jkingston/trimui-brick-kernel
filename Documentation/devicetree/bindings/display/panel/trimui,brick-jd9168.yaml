## drivers/soc/sunxi/Kconfig
```kconfig
# SPDX-License-Identifier: GPL-2.0-only
#
# Allwinner sunXi SoC drivers
#

config SUNXI_MBUS
	bool
	default ARCH_SUNXI
	depends on ARM || ARM64
	help
	  Say y to enable the fixups needed to support the Allwinner
	  MBUS DMA quirks.

config SUNXI_SRAM
	bool
	default ARCH_SUNXI
	select REGMAP_MMIO
	help
	  Say y here to enable the SRAM controller support. This
	  device is responsible on mapping the SRAM in the sunXi SoCs
	  whether to the CPU/DMA, or to the devices.

config SUN50I_A133_VE_DOMAIN
	bool
	default ARCH_SUNXI
	depends on RESET_CONTROLLER
	help
	  Own the clock and reset domain shared by the Cedrus and Hantro G2
	  video decoders on the Allwinner A133.
```
