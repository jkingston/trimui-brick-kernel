## Documentation/devicetree/bindings/display/panel/trimui,brick-jd9168.yaml
```yaml
# SPDX-License-Identifier: (GPL-2.0-only OR BSD-2-Clause)
%YAML 1.2
---
$id: http://devicetree.org/schemas/display/panel/trimui,brick-jd9168.yaml#
$schema: http://devicetree.org/meta-schemas/core.yaml#

title: TrimUI Brick JD9168 DSI panel

maintainers:
  - Jack Kingston <998656+jkingston@users.noreply.github.com>

allOf:
  - $ref: panel-common.yaml#

properties:
  compatible:
    const: trimui,brick-jd9168
  reg:
    maxItems: 1
  dsi-lanes:
    $ref: /schemas/types.yaml#/definitions/uint32
    const: 4
  reset-gpios:
    maxItems: 1
  backlight: true
  power0-supply:
    description: Shared 1.8 V CLDO1 supply
  power1-supply:
    description: 3.3 V CLDO4 supply
  pinctrl-names:
    items:
      - const: active
      - const: sleep
  pinctrl-0: true
  pinctrl-1: true
  display-timings:
    $ref: /schemas/display/panel/display-timings.yaml#

required:
  - compatible
  - reg
  - dsi-lanes
  - reset-gpios
  - backlight
  - power0-supply
  - power1-supply
  - pinctrl-names
  - pinctrl-0
  - pinctrl-1
  - display-timings

unevaluatedProperties: false
```

## Documentation/devicetree/bindings/gpu/allwinner,sun50i-a133-gpu.yaml
```yaml
# SPDX-License-Identifier: (GPL-2.0-only OR BSD-2-Clause)
%YAML 1.2
---
$id: http://devicetree.org/schemas/gpu/allwinner,sun50i-a133-gpu.yaml#
$schema: http://devicetree.org/meta-schemas/core.yaml#

title: Allwinner A133 PowerVR GE8300 GPU

maintainers:
  - Jack Kingston <998656+jkingston@users.noreply.github.com>

properties:
  compatible:
    items:
      - const: allwinner,sun50i-a133-gpu
      - const: img,gpu
  reg:
    maxItems: 1
  interrupts:
    maxItems: 1
  interrupt-names:
    const: IRQGPU
  clocks:
    items:
      - description: GPU core clock
      - description: GPU bus clock
      - description: PPU bus clock
  clock-names:
    items:
      - const: core
      - const: bus
      - const: ppu
  power-domains:
    maxItems: 1

required:
  - compatible
  - reg
  - interrupts
  - interrupt-names
  - clocks
  - clock-names
  - power-domains

additionalProperties: false
```

## Documentation/devicetree/bindings/interrupt-controller/allwinner,sun50i-a133-wakeupgen.yaml
```yaml
# SPDX-License-Identifier: (GPL-2.0-only OR BSD-2-Clause)
%YAML 1.2
---
$id: http://devicetree.org/schemas/interrupt-controller/allwinner,sun50i-a133-wakeupgen.yaml#
$schema: http://devicetree.org/meta-schemas/core.yaml#

title: Allwinner A133 firmware wakeup interrupt routing

maintainers:
  - Jack Kingston <998656+jkingston@users.noreply.github.com>

description: |
  An interrupt domain above the GIC routes wake enable/disable requests to
  firmware and its SCP. Ordinary interrupt operations are forwarded to the
  GIC. The boot loader must initialize the matching firmware, SCP firmware,
  DRAM parameters and service device tree before entering Linux. The native
  compatible requires service UUID 2052c028-f921-540c-8330-bba08ba2c772,
  ABI major 1, and both wake-source and raw-SPI-index capabilities.

allOf:
  - $ref: /schemas/interrupt-controller.yaml#

properties:
  compatible:
    oneOf:
      - const: allwinner,sun50i-a133-wakeupgen
        description: Stock secure-monitor wake service.
      - const: allwinner,sun50i-a133-native-wakeupgen
        description: Versioned native A133 wake service.

  interrupt-controller: true

  interrupt-parent: true

  "#interrupt-cells":
    const: 3
    description: |
      First cell is GIC_SPI (0); second is the SPI index, without the GIC
      INTID offset of 32; third is the GIC interrupt trigger type.
      PPIs must be connected directly to the GIC.

required:
  - compatible
  - interrupt-controller
  - interrupt-parent
  - "#interrupt-cells"

additionalProperties: false

examples:
  - |
    interrupt-controller {
        compatible = "allwinner,sun50i-a133-wakeupgen";
        interrupt-controller;
        interrupt-parent = <&gic>;
        #interrupt-cells = <3>;
    };
```

## Documentation/devicetree/bindings/iommu/allwinner,sun50i-a133-iommu.yaml
```yaml
# SPDX-License-Identifier: (GPL-2.0-only OR BSD-2-Clause)
%YAML 1.2
---
$id: http://devicetree.org/schemas/iommu/allwinner,sun50i-a133-iommu.yaml#
$schema: http://devicetree.org/meta-schemas/core.yaml#

title: Allwinner A133 IOMMU

maintainers:
  - Jack Kingston <998656+jkingston@users.noreply.github.com>

description: |
  One translation root is shared by seven masters. Each master ID must belong
  to exactly one consumer; consumers share one IOMMU group. Unattached masters
  retain physical bypass. Master IDs are 0 through 6. This variant uses direct
  read/write permission bits rather than H6 authority-control indices.

properties:
  compatible:
    const: allwinner,sun50i-a133-iommu
  reg:
    maxItems: 1
  interrupts:
    maxItems: 1
  clocks:
    maxItems: 1
  "#iommu-cells":
    const: 1
    description: Hardware master ID (0 through 6).

required:
  - compatible
  - reg
  - interrupts
  - clocks
  - "#iommu-cells"

additionalProperties: false
```

## Documentation/devicetree/bindings/media/allwinner,sun50i-a133-g2d.yaml
```yaml
# SPDX-License-Identifier: (GPL-2.0-only OR BSD-2-Clause)
%YAML 1.2
---
$id: http://devicetree.org/schemas/media/allwinner,sun50i-a133-g2d.yaml#
$schema: http://devicetree.org/meta-schemas/core.yaml#

title: Allwinner A133 G2D image processor

maintainers:
  - Jack Kingston <998656+jkingston@users.noreply.github.com>

description: |
  The G2D block contains mixer and rotation engines sharing clocks, reset,
  interrupt and IOMMU master. One driver must own the whole block.

properties:
  compatible:
    const: allwinner,sun50i-a133-g2d
  reg:
    maxItems: 1
  interrupts:
    maxItems: 1
  clocks:
    items:
      - description: Bus interface clock
      - description: Module clock
      - description: Memory bus clock
  clock-names:
    items:
      - const: bus
      - const: mod
      - const: ram
  resets:
    maxItems: 1
  iommus:
    maxItems: 1

required:
  - compatible
  - reg
  - interrupts
  - clocks
  - clock-names
  - resets
  - iommus

additionalProperties: false
```

## Documentation/devicetree/bindings/media/allwinner,sun50i-h6-vpu-g2.yaml
```yaml
# SPDX-License-Identifier: (GPL-2.0 OR BSD-2-Clause)
%YAML 1.2
---
$id: http://devicetree.org/schemas/media/allwinner,sun50i-h6-vpu-g2.yaml#
$schema: http://devicetree.org/meta-schemas/core.yaml#

title: Hantro G2 VPU codec implemented on Allwinner SoCs

maintainers:
  - Jernej Skrabec <jernej.skrabec@gmail.com>

description:
  Hantro G2 video decode accelerator present on Allwinner H6 and A133 SoCs.

properties:
  compatible:
    enum:
      - allwinner,sun50i-a133-vpu-g2
      - allwinner,sun50i-h6-vpu-g2

  reg:
    maxItems: 1

  interrupts:
    maxItems: 1

  clocks:
    minItems: 2
    maxItems: 3

  clock-names:
    minItems: 2
    maxItems: 3

  resets:
    maxItems: 1

  allwinner,video-engine-domain:
    $ref: /schemas/types.yaml#/definitions/phandle
    description: Shared clock and reset domain on A133

  iommus:
    maxItems: 1

required:
  - compatible
  - reg
  - interrupts

allOf:
  - if:
      properties:
        compatible:
          const: allwinner,sun50i-a133-vpu-g2
    then:
      properties:
        clocks: false
        clock-names: false
        resets: false
        iommus: false
      required:
        - allwinner,video-engine-domain
    else:
      properties:
        clocks:
          items:
            - description: Bus Clock
            - description: Module Clock
        clock-names:
          items:
            - const: bus
            - const: mod
      required:
        - iommus
        - clocks
        - clock-names
        - resets

additionalProperties: false

examples:
  - |
    #include <dt-bindings/interrupt-controller/arm-gic.h>
    #include <dt-bindings/clock/sun50i-h6-ccu.h>
    #include <dt-bindings/reset/sun50i-h6-ccu.h>

    video-codec-g2@1c00000 {
        compatible = "allwinner,sun50i-h6-vpu-g2";
        reg = <0x01c00000 0x1000>;
        interrupts = <GIC_SPI 90 IRQ_TYPE_LEVEL_HIGH>;
        clocks = <&ccu CLK_BUS_VP9>, <&ccu CLK_VP9>;
        clock-names = "bus", "mod";
        resets = <&ccu RST_BUS_VP9>;
        iommus = <&iommu 5>;
    };

...
```

## Documentation/devicetree/bindings/mfd/trimui,brick-pmic.yaml
```yaml
# SPDX-License-Identifier: (GPL-2.0-only OR BSD-2-Clause)
%YAML 1.2
---
$id: http://devicetree.org/schemas/mfd/trimui,brick-pmic.yaml#
$schema: http://devicetree.org/meta-schemas/core.yaml#

title: TrimUI Brick boot-established PMIC

maintainers:
  - Jack Kingston <998656+jkingston@users.noreply.github.com>

description: |
  Panel supply interface at I2C address 0x34. CLDO1 is a shared,
  boot-enabled 1.8 V rail; CLDO4 supplies the panel at 3.3 V. ALDO4 is
  boot-enabled at 1.8 V for audio; ALDO3 and BLDO1 are 3.3 V radio rails.
  The interface preserves inherited voltage selectors and shared CLDO1.
  Read-only battery voltage, initialized gauge capacity and USB input
  presence are provided by a child device. The interrupt controller routes
  power-key press and release events without changing key timing. Power-key
  press can wake suspend-to-idle through the nested PMIC interrupt and its
  R_INTC NMI parent. This does not establish deep-suspend support. Charging
  current limits remain boot-established unless explicitly written through
  power-supply properties. The Brick policy caps charge current at 1920 mA
  (stock's encoded 1950 mA setting) and USB input at 2500 mA. These are
  configuration limits, not measured current or negotiated source capability.
  Voltage, gauge and suspend charging configuration are not changed.
  Optional VMID and drivevbus regulators expose
  the independent boost and output switch on nonzero-selector AXP2202 parts.
  The output switch has an explicit vin-supply parent reference to VMID;
  each provider has a 1000 microsecond enable delay.

properties:
  compatible:
    const: trimui,brick-pmic
  interrupts:
    maxItems: 1
  reg:
    maxItems: 1
  regulators:
    type: object
    additionalProperties: false
    properties:
      aldo3:
        type: object
        $ref: /schemas/regulator/regulator.yaml#
        unevaluatedProperties: false
        required:
          - regulator-always-on
      aldo4:
        type: object
        $ref: /schemas/regulator/regulator.yaml#
        unevaluatedProperties: false
        required:
          - regulator-always-on
      bldo1:
        type: object
        $ref: /schemas/regulator/regulator.yaml#
        unevaluatedProperties: false
        required:
          - regulator-always-on
      cldo1:
        type: object
        $ref: /schemas/regulator/regulator.yaml#
        unevaluatedProperties: false
        required:
          - regulator-always-on
      vmid:
        type: object
        $ref: /schemas/regulator/regulator.yaml#
        unevaluatedProperties: false
      drivevbus:
        type: object
        $ref: /schemas/regulator/regulator.yaml#
        properties:
          vin-supply:
            description: Parent VMID boost regulator
        required:
          - vin-supply
        unevaluatedProperties: false
      cldo3:
        type: object
        $ref: /schemas/regulator/regulator.yaml#
        unevaluatedProperties: false
        required:
          - regulator-always-on
      cldo4:
        type: object
        $ref: /schemas/regulator/regulator.yaml#
        unevaluatedProperties: false
    dependencies:
      vmid: [drivevbus]
      drivevbus: [vmid]
    required:
      - aldo3
      - aldo4
      - bldo1
      - cldo1
      - cldo4

required:
  - compatible
  - reg
  - interrupts
  - regulators

additionalProperties: false
```

## Documentation/devicetree/bindings/mmc/trimui,brick-radio-pwrseq.yaml
```yaml
# SPDX-License-Identifier: (GPL-2.0-only OR BSD-2-Clause)
%YAML 1.2
---
$id: http://devicetree.org/schemas/mmc/trimui,brick-radio-pwrseq.yaml#
$schema: http://devicetree.org/meta-schemas/core.yaml#

title: TrimUI Brick shared-clock WLAN power sequence

maintainers:
  - Jack Kingston <998656+jkingston@users.noreply.github.com>

description: |
  Holds both shared radio clocks before releasing WLAN reset. Reset is held
  on clock acquisition failure. Reset release is followed by a 100 ms delay.

properties:
  compatible:
    const: trimui,brick-radio-pwrseq
  clocks:
    items:
      - description: Shared low-power reference clock
      - description: Shared high-frequency reference clock
  clock-names:
    items:
      - const: lpo
      - const: ref
  reset-gpios:
    maxItems: 1
    description: Active-low WLAN reset

required:
  - compatible
  - clocks
  - clock-names
  - reset-gpios

additionalProperties: false
```

## Documentation/devicetree/bindings/net/bluetooth/xradio,xr829-bt.yaml
```yaml
# SPDX-License-Identifier: (GPL-2.0-only OR BSD-2-Clause)
%YAML 1.2
---
$id: http://devicetree.org/schemas/net/bluetooth/xradio,xr829-bt.yaml#
$schema: http://devicetree.org/meta-schemas/core.yaml#

title: Xradio XR829 Bluetooth controller

maintainers:
  - Jack Kingston <998656+jkingston@users.noreply.github.com>

description:
  The XR829 Bluetooth function uses an H4 UART with hardware flow control.
  Firmware is loaded into controller RAM after reset. Power supplies may be
  shared with the Wi-Fi function and must have independent consumer references.

allOf:
  - $ref: /schemas/serial/serial-peripheral-props.yaml#

properties:
  compatible:
    const: xradio,xr829-bt

  vbat-supply:
    description: Controller main power supply.

  vddio-supply:
    description: Controller I/O power supply.

  reset-gpios:
    maxItems: 1
    description: Active-low controller reset.

  device-wake-gpios:
    maxItems: 1
    description: Active-high host signal requesting the controller remain awake.

  clocks:
    items:
      - description: Shared low-power reference clock
      - description: Shared high-frequency reference clock

  clock-names:
    items:
      - const: lpo
      - const: ref

required:
  - compatible
  - vbat-supply
  - vddio-supply
  - reset-gpios
  - device-wake-gpios
  - clocks
  - clock-names

dependencies:
  clocks: [clock-names]
  clock-names: [clocks]

unevaluatedProperties: false

examples:
  - |
    #include <dt-bindings/gpio/gpio.h>

    serial {
        bluetooth {
            compatible = "xradio,xr829-bt";
            clocks = <&rtc 0>, <&rtc 1>;
            clock-names = "lpo", "ref";
            vbat-supply = <&vbat>;
            vddio-supply = <&vddio>;
            reset-gpios = <&gpio 2 GPIO_ACTIVE_LOW>;
            device-wake-gpios = <&gpio 4 GPIO_ACTIVE_HIGH>;
        };
    };
```

## Documentation/devicetree/bindings/phy/allwinner,sun50i-a133-dphy.yaml
```yaml
# SPDX-License-Identifier: (GPL-2.0-only OR BSD-2-Clause)
%YAML 1.2
---
$id: http://devicetree.org/schemas/phy/allwinner,sun50i-a133-dphy.yaml#
$schema: http://devicetree.org/meta-schemas/core.yaml#

title: Allwinner A133 MIPI D-PHY controller

maintainers:
  - Jack Kingston <998656+jkingston@users.noreply.github.com>

properties:
  compatible:
    const: allwinner,sun50i-a133-dphy
  reg:
    items:
      - description: D-PHY registers
      - description: SoC revision register
  reg-names:
    items:
      - const: phy
      - const: soc-revision
  clocks:
    items:
      - description: Bus clock
      - description: Module clock
  clock-names:
    items:
      - const: bus
      - const: mod
  resets:
    maxItems: 1
  '#phy-cells':
    const: 0

required:
  - compatible
  - reg
  - reg-names
  - clocks
  - clock-names
  - resets
  - '#phy-cells'

additionalProperties: false
```
