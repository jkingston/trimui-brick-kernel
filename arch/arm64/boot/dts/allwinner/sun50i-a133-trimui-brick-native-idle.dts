// SPDX-License-Identifier: (GPL-2.0+ OR MIT)
/dts-v1/;

#include "sun50i-a133-trimui-brick.dts"
#include "sun50i-a133-stock-psci-idle.dtsi"

/ {
	model = "TrimUI Brick (native CPU idle qualification)";

	chosen {
		trimui,cpu-idle-qualification;
	};
};
