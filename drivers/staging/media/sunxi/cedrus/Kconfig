## drivers/staging/media/sunxi/cedrus/Kconfig
```kconfig
# SPDX-License-Identifier: GPL-2.0
config VIDEO_SUNXI_CEDRUS
	tristate "Allwinner Cedrus VPU driver"
	depends on VIDEO_DEV
	depends on RESET_CONTROLLER
	depends on HAS_DMA
	depends on OF
	select MEDIA_CONTROLLER
	select SUNXI_SRAM
	select VIDEOBUF2_DMA_CONTIG
	select V4L2_JPEG_HELPER
	select V4L2_MEM2MEM_DEV
	help
	  Support for the VPU found in Allwinner SoCs, also known as the Cedar
	  video engine.

	  To compile this driver as a module, choose M here: the module
	  will be called sunxi-cedrus.

config VIDEO_SUNXI_CEDRUS_ENCODER_CORE
	bool "Allwinner Cedrus encoder frontend and contract helpers"
	depends on VIDEO_SUNXI_CEDRUS
	help
	  Build the stateful V4L2 mem2mem encoder frontend and hardware-contract
	  helpers. The frontend remains hidden unless a SoC backend supplies every
	  required lifecycle callback, standard format and standard control, and
	  satisfies the complete encoder contract. No current variant does so.

config VIDEO_SUNXI_CEDRUS_ENCODER_CORE_KUNIT_TEST
	bool "KUnit tests for Cedrus encoder contract helpers" if !KUNIT_ALL_TESTS
	depends on KUNIT
	depends on VIDEO_SUNXI_CEDRUS_ENCODER_CORE
	default KUNIT_ALL_TESTS
	help
	  Run tests for the fail-closed encoder backend/frontend gate and the
	  proven A133 source, bitstream, interrupt and QP-field register contracts.
	  The tests exercise only pure contract helpers.  They do not access
	  encoder hardware or register an encoder video node.

config VIDEO_SUNXI_CEDRUS_KUNIT_TEST
	bool "KUnit tests for the Cedrus codec helpers" if !KUNIT_ALL_TESTS
	depends on KUNIT=y
	depends on VIDEO_SUNXI_CEDRUS=y
	default KUNIT_ALL_TESTS
	help
	  Run tests for software-only Cedrus codec helpers. These tests do not
	  access video-engine hardware. The suite verifies JPEG quantization
	  table generation, the A133 hardware table representation, and the
	  baseline JPEG header emitted for the encoder.
```
